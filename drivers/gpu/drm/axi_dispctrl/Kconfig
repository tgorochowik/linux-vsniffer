## drivers/gpu/drm/axi_dispctrl/Kconfig
```kconfig
config DRM_AXI_DISPCTRL
	tristate "DRM Support for display contorller on Zynq platforms"
	depends on DRM
	default n
	select DRM_KMS_HELPER
	select XILINX_DMA_ENGINES
	select XILINX_VDMA
	select DRM_KMS_CMA_HELPER
	select VT_HW_CONSOLE_BINDING if FRAMEBUFFER_CONSOLE
```

## drivers/media/platform/antmicro/Kconfig
```kconfig
config ANTMICRO_HISPI_INTERFACE
        tristate "Antmicro HiSpi interface support"
        depends on V4L_PLATFORM_DRIVERS
        default m
        ---help---
          HiSpi interface support driver.
```
